## config/boards/shields/hane/Kconfig.defconfig
```kconfig
if SHIELD_HANE_LEFT

config ZMK_KEYBOARD_NAME
	default "Hane"

config ZMK_SPLIT_BLE_ROLE_CENTRAL
	default y

endif

if SHIELD_HANE_RIGHT

config ZMK_KEYBOARD_NAME
	default "Hane Right"
	
endif
```
